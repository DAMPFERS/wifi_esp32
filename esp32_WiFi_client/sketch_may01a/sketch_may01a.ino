#include <WiFi.h> // Подключение библиотеки WiFi для работы с Wi-Fi модулем

//const char* host = "192.168.43.98"; 
const char* host = "192.168.1.107"; // IP-адрес хоста, к которому будет подключаться устройство
uint16_t port = 1984; // Порт, на котором будет происходить подключение
//const char* ssid     = "Honor 8C"; /
//const char* password = "89243536319"; 
const char* ssid     = "SumОм"; // Имя сети Wi-Fi, к которой будет подключаться устройство
const char* password = "sumomsumom"; // Пароль сети Wi-Fi

void setup() {
  Serial.begin(9600); // Инициализация последовательного порта для отладки
  WiFi.begin(ssid, password); // Начало подключения к сети Wi-Fi с указанными SSID и паролем
  delay(200); // Задержка в 200 миллисекунд
  //Serial.print("Connecting... "); //  вывод сообщения о подключении
  while (WiFi.status() != WL_CONNECTED) // Цикл ожидания подключения к сети Wi-Fi
  {
    Serial.print("."); // Вывод точки в последовательный порт для индикации процесса подключения
    delay(500); // Задержка в 500 миллисекунд
  }
  //Serial.print("Connected to "); //  вывод сообщения о успешном подключении
  //Serial.println(ssid); //  вывод имени сети, к которой подключено устройство
  //Serial.println("\nStarting connection to server..."); //  вывод сообщения о начале подключения к серверу
  delay(1000); // Задержка в 1 секунду
}

void loop() {
  WiFiClient client; // Создание объекта клиента Wi-Fi

  if (!client.connect(host,port)) // Попытка подключения к серверу по указанному хосту и порту
    delay(3000); // Задержка в 3 секунды, если подключение не удалось
    
  if (client.connected()) // Проверка, подключен ли клиент к серверу
  {
    client.print("12"); // Отправка строки "12" на сервер
    delay(2000); // Задержка в 2 секунды
    char w[15]; // Создание массива для хранения полученных данных
    int count = client.available(); // Получение количества доступных байт для чтения
    for(int i = 0; i < count; i++) // Цикл чтения доступных байт
      w[i] = client.read(); // Чтение байта и сохранение его в массив
    for(int i = 0; i < 3; i++) // Цикл вывода первых трех байт
      Serial.print(w[i]); // Вывод байта в последовательный порт
    client.stop(); // Завершение соединения с сервером
  }
}
